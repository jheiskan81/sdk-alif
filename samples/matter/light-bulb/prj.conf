## prj.conf
```kconfig
#  Copyright (C) 2024 Alif Semiconductor - All Rights Reserved.
#  Use, distribution and modification of this code is permitted under the
#  terms stated in the Alif Semiconductor Software License Agreement
#
#  You should have received a copy of the Alif Semiconductor Software
#  License Agreement with this file. If not, please write to:
#  contact@alifsemi.com, or visit: https://alifsemi.com/license

# Disable XIP
CONFIG_XIP=y

# Enable CHIP
CONFIG_CHIP=y
CONFIG_CHIP_PROJECT_CONFIG="src/include/CHIPProjectConfig.h"
# 32773 == 0x8005 (example lighting-app)
CONFIG_CHIP_DEVICE_PRODUCT_ID=32773
CONFIG_STD_CPP17=y

CONFIG_OPENTHREAD_THREAD_STACK_SIZE=8000
CONFIG_LOG_MODE_DEFERRED=y
CONFIG_LOG=y
CONFIG_SHELL=y
CONFIG_LOG_BUFFER_SIZE=5020

# General networking settings
CONFIG_NET_IF_MCAST_IPV6_ADDR_COUNT=14

# Enable CHIP pairing automatically on application start.
CONFIG_CHIP_ENABLE_PAIRING_AUTOSTART=y
# After system reset subscribe request are activated a properly automatically
CONFIG_CHIP_PERSISTENT_SUBSCRIPTIONS=y

# Enable PWM
CONFIG_PWM=y

# OpenThread configuration
CONFIG_NET_L2_OPENTHREAD=y

#Network setup
CONFIG_NET_TCP=y
CONFIG_NET_IPV6_NBR_CACHE=n
CONFIG_NET_IPV6_MLD=n
CONFIG_NET_CONFIG_NEED_IPV4=n

## Openthread parameters
CONFIG_SHELL=y
CONFIG_OPENTHREAD_SHELL=y
CONFIG_SHELL_STACK_SIZE=3072
CONFIG_OPENTHREAD_THREAD_VERSION_1_3=y
CONFIG_OPENTHREAD_FTD=y
CONFIG_OPENTHREAD_PING_SENDER=y
# Matter stack will will enable 15.4 interface
CONFIG_OPENTHREAD_MANUAL_START=y

# Bluetooth Low Energy configuration
CONFIG_BT_DEVICE_NAME="MatterLight"
CONFIG_BT_DEVICE_NAME_DYNAMIC=n

# Change a default passcode and verify
CONFIG_CHIP_DEVICE_SPAKE2_PASSCODE=20202022
CONFIG_CHIP_DEVICE_SPAKE2_TEST_VERIFIER="3CvibQGwGgzNG5uZ/w8sBP3Jf6hitoyLk5d3sBZJ7T8ExDvEGJUdT5GL4JDdhBb6GhekImBb0M8ZGKWiq2SiXk+SPsJqpMjhlngqDbkuYcECP8+J5Kv+MUwlGUa5KgX2nQ=="

# BT configuration

CONFIG_BT=y
CONFIG_BT_CENTRAL=y
CONFIG_BT_PERIPHERAL=y
CONFIG_BT_PRIVACY=n
CONFIG_BT_SMP=y
CONFIG_BT_SIGNING=y
CONFIG_BT_ATT_PREPARE_COUNT=2
CONFIG_BT_GATT_CLIENT=y
CONFIG_BT_L2CAP_DYNAMIC_CHANNEL=y
CONFIG_BT_TINYCRYPT_ECC=y
CONFIG_BT_SHELL=y
CONFIG_BT_L2CAP_TX_BUF_COUNT=4
CONFIG_BT_ID_MAX=2
CONFIG_BT_EATT=y
CONFIG_BT_L2CAP_ECRED=y
CONFIG_BT_GATT_DYNAMIC_DB=y
CONFIG_BT_FILTER_ACCEPT_LIST=y
CONFIG_BT_REMOTE_INFO=y
CONFIG_BT_REMOTE_VERSION=y
CONFIG_BT_GATT_AUTO_DISCOVER_CCC=y

CONFIG_BT_EXT_ADV=y
CONFIG_BT_EXT_ADV_LEGACY_SUPPORT=y
CONFIG_BT_PER_ADV=y
CONFIG_BT_PER_ADV_SYNC=y

CONFIG_BT_USER_DATA_LEN_UPDATE=y
CONFIG_BT_AUTO_DATA_LEN_UPDATE=y

CONFIG_BT_USER_PHY_UPDATE=y
CONFIG_BT_AUTO_PHY_UPDATE=y

# Other settings
CONFIG_THREAD_NAME=y
CONFIG_CHIP_LIB_SHELL=y

# Reduce application size
CONFIG_USE_SEGGER_RTT=n

# Flash and Settings storage configutaion
CONFIG_FLASH=y
CONFIG_FLASH_PAGE_LAYOUT=y
CONFIG_FLASH_MAP=y
CONFIG_NVS=y
CONFIG_SETTINGS=y

# Disable GET Opt for fix duplicate implementation
CONFIG_GETOPT=n
CONFIG_IEEE802154_ALIF_AHI_MSG_LIB=y
```

## src/AppTask.cpp
```c
/* Copyright (C) 2024 Alif Semiconductor - All Rights Reserved.
 * Use, distribution and modification of this code is permitted under the
 * terms stated in the Alif Semiconductor Software License Agreement
 *
 * You should have received a copy of the Alif Semiconductor Software
 * License Agreement with this file. If not, please write to:
 * contact@alifsemi.com, or visit: https://alifsemi.com/license
 */

#include "AppTask.h"

#include "AppConfig.h"
#include "MatterStack.h"
#include "MatterUi.h"
#include "PWMDevice.h"
#include "icdHandler.h"
#include <app/InteractionModelEngine.h>
#include <DeviceInfoProviderImpl.h>
#include <app-common/zap-generated/attributes/Accessors.h>
#include <app/DeferredAttributePersistenceProvider.h>
#include <app/clusters/identify-server/identify-server.h>
#include <app/server/Dnssd.h>
#include <app/server/OnboardingCodesUtil.h>
#include <app/server/Server.h>
#include <credentials/DeviceAttestationCredsProvider.h>
#include <credentials/examples/DeviceAttestationCredsExample.h>
#include <lib/core/ErrorStr.h>
#include <lib/support/CHIPMem.h>
#include <lib/support/CodeUtils.h>
#include <system/SystemClock.h>

#include <zephyr/kernel.h>
#include <zephyr/device.h>
#include <zephyr/drivers/pwm.h>
#include <zephyr/logging/log.h>

LOG_MODULE_DECLARE(app, CONFIG_CHIP_APP_LOG_LEVEL);

using namespace ::chip;
using namespace ::chip::app;
using namespace ::chip::DeviceLayer;

namespace
{

constexpr EndpointId kLightEndpointId = 1;
constexpr uint8_t kDefaultMinLevel = 0;
constexpr uint8_t kDefaultMaxLevel = 254;
constexpr int kAppEventQueueSize = 10;

K_MSGQ_DEFINE(sAppEventQueue, sizeof(AppEvent), kAppEventQueueSize, alignof(AppEvent));

// Create Identify server
Identify sIdentify = {kLightEndpointId, AppTask::IdentifyStartHandler, AppTask::IdentifyStopHandler,
		      Clusters::Identify::IdentifyTypeEnum::kVisibleIndicator};

chip::DeviceLayer::DeviceInfoProviderImpl gExampleDeviceInfoProvider;

DeferredAttribute gCurrentLevelPersister(
	ConcreteAttributePath(kLightEndpointId, Clusters::LevelControl::Id,
			      Clusters::LevelControl::Attributes::CurrentLevel::Id));
DeferredAttributePersistenceProvider
	gDeferredAttributePersister(Server::GetInstance().GetDefaultAttributePersister(),
				    Span<DeferredAttribute>(&gCurrentLevelPersister, 1),
				    System::Clock::Milliseconds32(5000));

const struct pwm_dt_spec sLightPwmDevice = PWM_DT_SPEC_GET(DT_ALIAS(pwm_led0));

} // namespace

CHIP_ERROR AppTask::DevInit()
{
	LOG_INF("Init Lighting-app cluster");

	// Initialize lighting device (PWM)
	uint8_t minLightLevel = kDefaultMinLevel;
	Clusters::LevelControl::Attributes::MinLevel::Get(kLightEndpointId, &minLightLevel);

	uint8_t maxLightLevel = kDefaultMaxLevel;
	Clusters::LevelControl::Attributes::MaxLevel::Get(kLightEndpointId, &maxLightLevel);

	uint8_t current = 0;
	app::DataModel::Nullable<uint8_t> currentLevel;

	Clusters::LevelControl::Attributes::CurrentLevel::Get(kLightEndpointId, currentLevel);
	if (!currentLevel.IsNull()) {
		current = currentLevel.Value();
	}

	int ret = Instance().mPWMDevice.Init(&sLightPwmDevice, minLightLevel, maxLightLevel, maxLightLevel);
	if (ret != 0) {
		return chip::System::MapErrorZephyr(ret);
	}
	// Register PWM device init and activate callback's
	Instance().mPWMDevice.SetCallbacks(ActionInitiated, ActionCompleted);
	/* SET a stored value */
	if (current) {
		AppTask::Instance().GetPWMDevice().InitiateAction(
			PWMDevice::LEVEL_ACTION,
			static_cast<int32_t>(AppEventType::Lighting),
			reinterpret_cast<uint8_t *>(&current));
	}

	// Init modified persistent storage setup
	gExampleDeviceInfoProvider.SetStorageDelegate(
		&Server::GetInstance().GetPersistentStorage());
	chip::DeviceLayer::SetDeviceInfoProvider(&gExampleDeviceInfoProvider);
	app::SetAttributePersistenceProvider(&gDeferredAttributePersister);
	MatterUi::Instance().Init(AppTask::ButtonUpdateHandler);

	return CHIP_NO_ERROR;
}

void AppTask::ButtonUpdateHandler(uint32_t button_state, uint32_t has_changed)
{
	if (has_changed & 1) {
		if (button_state & 1) {
			LOG_INF("Factoryreset button press");
		} else {
			LOG_INF("Factoryreset button released");
		}
		MatterUi::Instance().AppFactoryResetEventTrig();
	}
}

void AppTask::PostEvent(AppEvent *aEvent)
{
	if (!aEvent) {
		return;
	}

	if (k_msgq_put(&sAppEventQueue, aEvent, K_NO_WAIT) != 0) {
		LOG_INF("PostEvent fail");
	}
}

void AppTask::DispatchEvent(const AppEvent *aEvent)
{
	if (!aEvent) {
		return;
	}
	if (aEvent->Handler) {
		aEvent->Handler(aEvent);
	} else {
		LOG_INF("Dropping event without handler");
	}
}

void AppTask::GetEvent(AppEvent *aEvent)
{
	k_msgq_get(&sAppEventQueue, aEvent, K_FOREVER);
}

void AppTask::IdentifyStartHandler(Identify *)
{
	AppEvent event;
	event.Type = AppEventType::IdentifyStart;
	event.Handler = [](const AppEvent *) {
		MatterStack::Instance().IdentifyLedState(true);
		LOG_INF("Identify start");
	};
	PostEvent(&event);
}

void AppTask::IdentifyStopHandler(Identify *)
{
	AppEvent event;
	event.Type = AppEventType::IdentifyStop;
	event.Handler = [](const AppEvent *) {
		LOG_INF("Identify stop");
		MatterStack::Instance().IdentifyLedState(false);
	};
	PostEvent(&event);
}

void AppTask::LightingActionEventHandler(const AppEvent *event)
{
	if (event->Type != AppEventType::Lighting) {
		return;
	}

	PWMDevice::Action_t action = static_cast<PWMDevice::Action_t>(event->LightingEvent.Action);
	int32_t actor = event->LightingEvent.Actor;

	LOG_INF("Light state to %d by %d", action, actor);

	if (Instance().mPWMDevice.InitiateAction(action, actor, NULL)) {
		LOG_INF("Action is already in progress or active.");
	}
}

void AppTask::StartBLEAdvertisementHandler(const AppEvent *)
{
	if (Server::GetInstance().GetFabricTable().FabricCount() != 0) {
		LOG_INF("Matter service BLE advertising not started - device is already "
			"commissioned");
		return;
	}

	if (ConnectivityMgr().IsBLEAdvertisingEnabled()) {
		LOG_INF("BLE advertising is already enabled");
		return;
	}

	if (Server::GetInstance().GetCommissioningWindowManager().OpenBasicCommissioningWindow() !=
	    CHIP_NO_ERROR) {
		LOG_ERR("OpenBasicCommissioningWindow() failed");
	}
}

void AppTask::ActionInitiated(PWMDevice::Action_t action, int32_t actor)
{
	if (action == PWMDevice::ON_ACTION) {
		LOG_INF("Turn On Action has been initiated");
	} else if (action == PWMDevice::OFF_ACTION) {
		LOG_INF("Turn Off Action has been initiated");
	} else if (action == PWMDevice::LEVEL_ACTION) {
		LOG_INF("Level Action has been initiated");
	}
	MatterStack::Instance().StatusLedBlink();
}

void AppTask::ActionCompleted(PWMDevice::Action_t action, int32_t actor)
{
	if (action == PWMDevice::ON_ACTION) {
		LOG_INF("Turn On Action has been completed");
	} else if (action == PWMDevice::OFF_ACTION) {
		LOG_INF("Turn Off Action has been completed");
	} else if (action == PWMDevice::LEVEL_ACTION) {
		LOG_INF("Level Action has been completed");
	}

	if (actor == static_cast<int32_t>(AppEventType::ShellButton)) {
		Instance().UpdateClusterState();
	}
}

void AppTask::UpdateClusterState()
{
	SystemLayer().ScheduleLambda([this] {
		// write the new on/off value
		Protocols::InteractionModel::Status status =
			Clusters::OnOff::Attributes::OnOff::Set(kLightEndpointId,
								mPWMDevice.IsTurnedOn());

		if (status != Protocols::InteractionModel::Status::Success) {
			LOG_ERR("Updating on/off cluster failed: %x", to_underlying(status));
		}

		// write the current level
		status = Clusters::LevelControl::Attributes::CurrentLevel::Set(
			kLightEndpointId, mPWMDevice.GetLevel());

		if (status != Protocols::InteractionModel::Status::Success) {
			LOG_ERR("Updating level cluster failed: %x", to_underlying(status));
		}
	});
}

CHIP_ERROR AppTask::Init()
{
	/* Initialize Matter stack */
	ReturnErrorOnFailure(MatterStack::Instance().matter_stack_init(DevInit));

	chip::app::InteractionModelEngine::GetInstance()->RegisterReadHandlerAppCallback(
		&ICDHandler::Instance());

	/* Start Matter sheduler */
	ReturnErrorOnFailure(MatterStack::Instance().matter_stack_start());

	return CHIP_NO_ERROR;
}

CHIP_ERROR AppTask::StartApp()
{
	ReturnErrorOnFailure(Init());

	AppEvent event = {};

	while (true) {
		GetEvent(&event);
		DispatchEvent(&event);
	}

	return CHIP_NO_ERROR;
}
```
